## meta-ota-platform/conf/layer.conf
```bitbake
BBPATH .= ":${LAYERDIR}"

BBFILES += "${LAYERDIR}/recipes-*/*/*.bb \
            ${LAYERDIR}/recipes-*/*/*.bbappend"

BBFILE_COLLECTIONS += "otaplatform"
BBFILE_PATTERN_otaplatform := "^${LAYERDIR}/"
BBFILE_PRIORITY_otaplatform = "6"

LAYERDEPENDS_otaplatform = "core openembedded-layer"
LAYERSERIES_COMPAT_otaplatform = "scarthgap"
```
